## meta-mender-seeed/conf/machine/seeed-reterminal-mender.conf
```bitbake
require conf/machine/raspberrypi4-64.conf

RPI_KERNEL_DEVICETREE_OVERLAYS:append = " overlays/reTerminal.dtbo overlays/i2c3.dtbo"

KERNEL_MODULE_AUTOLOAD:rpi += "i2c-dev"

ENABLE_I2C = "1"

MENDER_STORAGE_TOTAL_SIZE_MB = "2048"

PREFERRED_VERSION_linux-raspberrypi ?= "6.6.%"

MACHINE_ESSENTIAL_EXTRA_RDEPENDS += " \
    kernel-image \
    kernel-devicetree \
    seeed-linux-dtoverlays \
"
```

## meta-mender-xilinx/meta-arty-z7/conf/layer.conf
```bitbake
# Layer for the Digilent Arty Z7-20 board (Zynq-7000)

BBPATH .= ":${LAYERDIR}"

BBFILES += "${LAYERDIR}/recipes-*/*/*.bb \
            ${LAYERDIR}/recipes-*/*/*.bbappend"

BBFILE_COLLECTIONS += "arty-z7"
BBFILE_PATTERN_arty-z7 = "^${LAYERDIR}/"
BBFILE_PRIORITY_arty-z7 = "7"

LAYERDEPENDS_arty-z7 = "core xilinx"
LAYERSERIES_COMPAT_arty-z7 = "scarthgap"
```
