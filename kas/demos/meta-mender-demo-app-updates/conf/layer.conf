## kas/demos/meta-mender-demo-app-updates/conf/layer.conf
```bitbake
# We have a conf and classes directory, add to BBPATH
BBPATH .= ":${LAYERDIR}"

# We have recipes-* directories, add to BBFILES
BBFILES += "${LAYERDIR}/recipes-*/*/*.bb \
            ${LAYERDIR}/recipes-*/*/*.bbappend"

BBFILE_COLLECTIONS += "meta-mender-demo-app-updates"
BBFILE_PATTERN_meta-mender-demo-app-updates = "^${LAYERDIR}/"
BBFILE_PRIORITY_meta-mender-demo-app-updates = "6"

LAYERDEPENDS_meta-mender-demo-app-updates = "core virtualization-layer"
LAYERSERIES_COMPAT_meta-mender-demo-app-updates = "scarthgap"

BBFILES_DYNAMIC += " \
    raspberrypi:${LAYERDIR}/dynamic-layers/raspberrypi/*/*/*.bb \
    raspberrypi:${LAYERDIR}/dynamic-layers/raspberrypi/*/*/*.bbappend \
"
```

## kas/demos/meta-mender-explicit-wic/conf/layer.conf
```bitbake
# We have a conf and classes directory, add to BBPATH
BBPATH .= ":${LAYERDIR}"

# We have recipes-* directories, add to BBFILES
BBFILES += "${LAYERDIR}/recipes-*/*/*.bb \
            ${LAYERDIR}/recipes-*/*/*.bbappend"

BBFILE_COLLECTIONS += "meta-mender-explicit-wic"
BBFILE_PATTERN_meta-mender-explicit-wic = "^${LAYERDIR}/"
BBFILE_PRIORITY_meta-mender-explicit-wic = "6"

LAYERVERSION_meta-mender-explicit-wic = "1"
LAYERDEPENDS_meta-mender-explicit-wic = "core"
LAYERSERIES_COMPAT_meta-mender-explicit-wic = "scarthgap"

# Variable to reference this layer directory in bbclass
LAYERDIR_meta-mender-explicit-wic = "${LAYERDIR}"
```

## kas/demos/meta-mender-explicit-wic/wic/mender-explicit-raspberrypi4-64.wks
```
# short-description: Mender A/B partition layout using explicit WIC (standard configuration)
# long-description: Creates the same 5-partition Mender A/B layout using explicit WKS
# file with standard WIC sources instead of Mender's dynamic image generation.
# Root B partition is left empty for OTA updates (standard deployment configuration).
#
# This demonstrates how to achieve identical Mender functionality using only
# standard Yocto WIC mechanisms while maintaining full A/B update compatibility.
#
# Partition layout:
# 1. U-Boot environment (8KB, no partition table entry)
# 2. Boot partition (100MB, FAT32, bootable)
# 3. Root filesystem A (512MB, ext4, active) - populated with rootfs
# 4. Root filesystem B (512MB, ext4, inactive) - empty for OTA updates
# 5. Data partition (128MB, ext4, persistent)

# U-Boot environment partition (stored before partition table)
# Contains A/B boot logic and state - essential for Mender updates
part --source rawcopy --sourceparams="file=uboot.env" --ondisk mmcblk0 --align 8192 --no-table

# Boot partition (100MB, FAT32, bootable)
# Uses standard bootimg-partition source which merges IMAGE_BOOT_FILES with boot files from rootfs
# This replicates exactly what mender-bootimg.bbclass would create
part /boot --source bootimg-partition --ondisk mmcblk0 --fstype=vfat --label boot --active --align 8192 --size 100

# Root filesystem A (512MB, ext4, active)
# Standard rootfs source - this is the active root partition for booting
part / --source rootfs --ondisk mmcblk0 --fstype=ext4 --label rootA --align 8192 --fixed-size 512M

# Root filesystem B (512MB, ext4, inactive)
# Empty partition with same size as Root A - used for A/B updates
# Mender client will write new rootfs here during updates
part --ondisk mmcblk0 --fstype=ext4 --label rootB --align 8192 --fixed-size 512M

# Data partition (128MB, ext4, persistent)
# Uses rootfs source with change-directory=data to populate with /data contents
# This replicates what mender-dataimg.bbclass would create (minus bootstrap artifact)
part /data --source rootfs --change-directory=data --ondisk mmcblk0 --fstype=ext4 --label data --align 8192 --size 128

# Use MBR partition table (compatible with Raspberry Pi bootloader)
bootloader --ptable msdos
```

## kas/demos/meta-mender-raspberrypi-tpm/conf/layer.conf
```bitbake
# We have a conf and classes directory, add to BBPATH
BBPATH .= ":${LAYERDIR}"

# We have recipes-* directories, add to BBFILES
BBFILES += "${LAYERDIR}/recipes-*/*/*.bb \
            ${LAYERDIR}/recipes-*/*/*.bbappend"

BBFILE_COLLECTIONS += "meta-mender-raspberrypi-tpm"
BBFILE_PATTERN_meta-mender-raspberrypi-tpm = "^${LAYERDIR}/"
BBFILE_PRIORITY_meta-mender-raspberrypi-tpm = "6"

LAYERDEPENDS_meta-mender-raspberrypi-tpm = "core"
LAYERSERIES_COMPAT_meta-mender-raspberrypi-tpm = "scarthgap"
```

## kas/demos/meta-mender-swupdate/conf/layer.conf
```bitbake
# We have a conf and classes directory, add to BBPATH
BBPATH .= ":${LAYERDIR}"

# We have recipes-* directories, add to BBFILES
BBFILES += "${LAYERDIR}/recipes-*/*/*.bb \
            ${LAYERDIR}/recipes-*/*/*.bbappend"

BBFILE_COLLECTIONS += "mender-swupdate"
BBFILE_PATTERN_mender-swupdate = "^${LAYERDIR}/"
BBFILE_PRIORITY_mender-swupdate = "6"

LAYERSERIES_COMPAT_mender-swupdate = "kirkstone"
```

## kas/demos/meta-mender-swupdate/conf/machine/qemuarm64-swupdate.conf
```bitbake
MACHINEOVERRIDES =. "qemuarm64:"

require ${COREBASE}/meta/conf/machine/qemuarm64.conf

KMACHINE = "qemuarm64"

include conf/machine/include/soc-family.inc

WKS_FILE = "image-qemu.wks"

EXTRA_IMAGEDEPENDS:append = " virtual/bootloader"
PREFERRED_PROVIDER_virtual/bootloader = "u-boot"
IMAGE_BOOT_FILES = "u-boot.bin boot.scr"

# Support runqemu script
QB_DEFAULT_FSTYPE = "wic"
QB_DRIVE_TYPE = "/dev/vdb"
QB_SYSTEM_NAME = "qemu-system-aarch64"
QB_DEFAULT_BIOS = "u-boot.bin"

# Used to generate the swupdate update description file
OTA_PARTITION_A = "vda2"
OTA_PARTITION_B = "vda3"

IMAGE_FSTYPES:append = " ext4.gz wic wic.bmap"
MACHINE_ESSENTIAL_EXTRA_RDEPENDS += "kernel-image"
do_image_wic[depends] += "mtools-native:do_populate_sysroot dosfstools-native:do_populate_sysroot virtual/bootloader:do_deploy"
```

## kas/demos/meta-mender-swupdate/wic/image-qemu.wks
```
part /boot --fstype=vfat --ondisk vda --offset 2048s --align 4 --fixed-size 63M --active --label boot

# rootfs slot A
part / --source rootfs --fstype=ext4 --ondisk vda --label root-a --align 4 --fixed-size 256M

# rootfs slot B
part --fstype=ext4 --ondisk vda --label root-b --align 4 --fixed-size 256M

# /media (auto-mounted via /etc/fstab)
part --fstype=ext4 --ondisk vda --label media --align 4 --fixed-size 448M

bootloader --ptable msdos --timeout 1
```

## meta-mender-96boards/conf/layer.conf
```bitbake
# Copyright 2018 Northern.tech AS

# We have a conf and classes directory, add to BBPATH
BBPATH .= ":${LAYERDIR}"

# We have recipes-* directories, add to BBFILES
BBFILES += "${LAYERDIR}/recipes-*/*/*.bb \
	${LAYERDIR}/recipes-*/*/*.bbappend"

BBFILE_COLLECTIONS += "mender-96boards"
BBFILE_PATTERN_mender-96boards = "^${LAYERDIR}/"
BBFILE_PRIORITY_mender-96boards = "10"

LAYERSERIES_COMPAT_mender-96boards = "sumo"
```

## meta-mender-amlogic/conf/layer.conf
```bitbake
# Copyright 2018 Northern.tech AS

# We have a conf and classes directory, add to BBPATH
BBPATH .= ":${LAYERDIR}"

# We have recipes-* directories, add to BBFILES
BBFILES += "${LAYERDIR}/recipes-*/*/*.bb \
	${LAYERDIR}/recipes-*/*/*.bbappend"

BBFILE_COLLECTIONS += "mender-amlogic"
BBFILE_PATTERN_mender-amlogic = "^${LAYERDIR}/"
BBFILE_PRIORITY_mender-amlogic = "10"

LAYERSERIES_COMPAT_mender-amlogic = "dunfell"

LAYERDEPENDS_mender-amlogic = "meson"
```

## meta-mender-atmel/conf/layer.conf
```bitbake
# Copyright 2018 Northern.tech AS

# We have a conf and classes directory, add to BBPATH
BBPATH .= ":${LAYERDIR}"

# We have recipes-* directories, add to BBFILES
BBFILES += "${LAYERDIR}/recipes-*/*/*.bb \
	${LAYERDIR}/recipes-*/*/*.bbappend"

BBFILE_COLLECTIONS += "mender-atmel"
BBFILE_PATTERN_mender-atmel = "^${LAYERDIR}/"
BBFILE_PRIORITY_mender-atmel = "10"

LAYERSERIES_COMPAT_mender-atmel = "zeus"

LAYERDEPENDS_mender-atmel = "mender atmel"
```

## meta-mender-beaglebone/conf/layer.conf
```bitbake
# Copyright 2020 Northern.tech AS

# We have a conf and classes directory, add to BBPATH
BBPATH .= ":${LAYERDIR}"

# We have recipes-* directories, add to BBFILES
BBFILES += "${LAYERDIR}/recipes-*/*/*.bb \
	${LAYERDIR}/recipes-*/*/*.bbappend"

BBFILE_COLLECTIONS += "mender-community-beaglebone"
BBFILE_PATTERN_mender-community-beaglebone = "^${LAYERDIR}/"
BBFILE_PRIORITY_mender-community-beaglebone = "92"
LAYERSERIES_COMPAT_mender-community-beaglebone = "zeus"

LAYERDEPENDS_mender-community-beaglebone = "mender yoctobsp"
```

## meta-mender-clearfog/conf/layer.conf
```bitbake
# Copyright 2019 Northern.tech AS

# We have a conf and classes directory, add to BBPATH
BBPATH .= ":${LAYERDIR}"

# We have recipes-* directories, add to BBFILES
BBFILES += "${LAYERDIR}/recipes-*/*/*.bb \
	${LAYERDIR}/recipes-*/*/*.bbappend"

BBFILE_COLLECTIONS += "mender-clearfog"
BBFILE_PATTERN_mender-clearfog = "^${LAYERDIR}/"
BBFILE_PRIORITY_mender-clearfog = "10"

LAYERSERIES_COMPAT_mender-clearfog = "zeus"

LAYERDEPENDS_mender-clearfog = "mender meta-clearfog"
```

## meta-mender-client-only/conf/layer.conf
```bitbake
# We have a conf and classes directory, add to BBPATH
BBPATH .= ":${LAYERDIR}"

# We have recipes-* directories, add to BBFILES
BBFILES += "${LAYERDIR}/recipes-*/*/*.bb \
            ${LAYERDIR}/recipes-*/*/*.bbappend"

BBFILE_COLLECTIONS += "meta-mender-client-only"
BBFILE_PATTERN_meta-mender-client-only = "^${LAYERDIR}/"
BBFILE_PRIORITY_meta-mender-client-only = "6"

LAYERDEPENDS_meta-mender-client-only = "core"
LAYERSERIES_COMPAT_meta-mender-client-only = "scarthgap"
```

## meta-mender-coral/conf/layer.conf
```bitbake
# Copyright 2020 Northern.tech AS

# We have a conf and classes directory, add to BBPATH
BBPATH .= ":${LAYERDIR}"

# We have recipes-* directories, add to BBFILES
BBFILES += "${LAYERDIR}/recipes-*/*/*.bb \
	${LAYERDIR}/recipes-*/*/*.bbappend"

BBFILE_COLLECTIONS += "mender-coral"
BBFILE_PATTERN_mender-coral = "^${LAYERDIR}/"
BBFILE_PRIORITY_mender-coral = "10"

LAYERSERIES_COMPAT_mender-coral = "zeus"

LAYERDEPENDS_mender-coral = "mender coral-bsp"
```

## meta-mender-imx/conf/layer.conf
```bitbake
# We have a conf and classes directory, add to BBPATH
BBPATH .= ":${LAYERDIR}"

# We have a packages directory, add to BBFILES
BBFILES += "${LAYERDIR}/recipes-*/*/*.bb \
            ${LAYERDIR}/recipes-*/*/*.bbappend"

BBFILE_COLLECTIONS += "mender-imx"
BBFILE_PATTERN_mender-imx := "^${LAYERDIR}"
LAYERSERIES_COMPAT_mender-imx = "zeus"

# This needs to be higher priority than meta-imx
# We have to override the do_compile() function it provides for our newer
# u-boot version.
BBFILE_PRIORITY_mender-imx = "11"

LAYERDEPENDS_mender-imx = "mender freescale-layer fsl-bsp-release"
```

## meta-mender-nxp-imx6ull/conf/layer.conf
```bitbake
# Copyright 2018 Northern.tech AS

# We have a conf and classes directory, add to BBPATH
BBPATH .= ":${LAYERDIR}"

# We have recipes-* directories, add to BBFILES
BBFILES += "${LAYERDIR}/recipes-*/*/*.bb \
	${LAYERDIR}/recipes-*/*/*.bbappend"

BBFILE_COLLECTIONS += "mender-community-nxp-imx6ull"
BBFILE_PATTERN_mender-community-nxp-imx6ull = "^${LAYERDIR}/"
BBFILE_PRIORITY_mender-community-nxp-imx6ull = "92"
```

## meta-mender-octavo-osd32mp/conf/layer.conf
```bitbake
# Copyright 2023 António Oliveira (Konsulko Group)

# We have a conf and classes directory, add to BBPATH
BBPATH .= ":${LAYERDIR}"

# We have recipes-* directories, add to BBFILES
BBFILES += "${LAYERDIR}/recipes-*/*/*.bb \
	${LAYERDIR}/recipes-*/*/*.bbappend"

BBFILE_COLLECTIONS += "mender-community-st-stm32mp"
BBFILE_PATTERN_mender-community-st-stm32mp = "^${LAYERDIR}/"
BBFILE_PRIORITY_mender-community-st-stm32mp = "5"
LAYERSERIES_COMPAT_mender-community-st-stm32mp = "kirkstone"
```

## meta-mender-octavo-osd32mp/conf/machine/include/osd32mp1.inc
```bitbake
include conf/machine/include/st-machine-common-stm32mp.inc
include conf/machine/include/st-machine-providers-stm32mp.inc

#
# This machine configuration is largely based on ST's machine config for the
# EK and DK boards.
# It focuses mainly on the mender integration and most peripherals/features not
# strictly necessary are disabled to a) keep things simple and b) reduce any
# potential sources of enthropy.
# It is possible to enable these features, possibly acompanied by changes to the
# devicetree to enable/configure the related peripherals.

# Define specific familly common machine name
MACHINEOVERRIDES .= ":stm32mp1common:stm32mp15common"

# =========================================================================
# Chip architecture
# =========================================================================
DEFAULTTUNE = "cortexa7thf-neon-vfpv4"
include conf/machine/include/arm/armv7a/tune-cortexa7.inc

# =========================================================================
# boot scheme
# =========================================================================
# Only trusted is supported for now. Optee should work too only requiring the
# matching devicetree for the board.
BOOTSCHEME_LABELS += "trusted"
#BOOTSCHEME_LABELS += "optee"

OSD32MP1_DEVICETREE = "stm32mp157c-osd32mp1-red"

STM32MP_DEVICETREE:append = " ${OSD32MP1_DEVICETREE}"

# =========================================================================
# Machine features
# =========================================================================
#MACHINE_FEATURES += "splashscreen"
MACHINE_FEATURES += "watchdog"
MACHINE_FEATURES += "bluetooth"
MACHINE_FEATURES += "wifi"
#MACHINE_FEATURES += "gpu"
#MACHINE_FEATURES += "m4copro"

# Bluetooth
BLUETOOTH_LIST += "linux-firmware-bluetooth-bcm4343"
# Wifi
WIFI_LIST += "linux-firmware-bcm43430"

# =========================================================================
# Kernel
# =========================================================================
KERNEL_MODULE_AUTOLOAD = " \
    brcmfmac \
"

UBOOT_EXTLINUX_FDT = "/${OSD32MP1_DEVICETREE}.dtb"
```
