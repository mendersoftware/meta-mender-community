## meta-mender-octavo-osd32mp/conf/machine/osd32mp1-emmc-mender.conf
```bitbake
#@TYPE: Machine
#@NAME: osd32mp1-emmc-mender
#@DESCRIPTION: OSD32MP1-RED Evaluation Board. Boot from eMMC with mender OTA updates
#@NEEDED_BSPLAYERS: meta-st-stm32mp meta-st-openstlinux

require conf/machine/include/osd32mp1.inc

# disable bootfs: with mender, kernel and the devicetree are
# picked directly from /boot in the rootfs partition
ST_BOOTFS = "0"
ST_USERFS = "0"
ST_VENDORFS = "0"

MACHINE_FEATURES:remove = " initrd autoresize"

BOOTDEVICE_LABELS += "emmc"

DEVICE_BOARD_ENABLE:EMMC += "${OSD32MP1_DEVICETREE}"

ACCEPT_EULA_osd32mp1-emmc-mender = "1"

#####################################################
### Mender configuration ###

MENDER_DTB_NAME = "${KERNEL_DEVICETREE}"

MENDER_STORAGE_DEVICE = "/dev/mmcblk1"

# datta partition: /dev/mmcblk1p8
MENDER_DATA_PART = "${MENDER_STORAGE_DEVICE_BASE}8"

# rootfs A: /dev/mmcblk1p6
MENDER_ROOTFS_PART_A = "${MENDER_STORAGE_DEVICE_BASE}6"

# rootfs B: /dev/mmcblk1p7
MENDER_ROOTFS_PART_B = "${MENDER_STORAGE_DEVICE_BASE}7"

# environment offset in MMC1: 0x980000
MENDER_UBOOT_ENV_STORAGE_DEVICE_OFFSET_1 = "9961472"

# redundant environment offset in MMC1: 0x9c0000
MENDER_UBOOT_ENV_STORAGE_DEVICE_OFFSET_2 = "10223616"

# environment size set to 16k (after adding mender default env is ~6k)
BOOTENV_SIZE = "0x4000"

# total storage, in MiB
# size of rootfs is ~ (TOTAL_SIZE_MB - DATA_SIZE_MB)/2
MENDER_STORAGE_TOTAL_SIZE_MB ?= "1000"

#
# force mender to not place an entry in /etc/fstab for
# the u-boot partition (/uboot)
MENDER_BOOT_PART_SIZE_MB = "0"
MENDER_BOOT_PART = ""

# Keep this small, it'll be grown on the first boot.
# NB: may need to grow if there are files being placed
# in /data which don't fit in the current size
MENDER_DATA_PART_SIZE_MB ?= "8"

#
# Enable generation of the image for the data partition
IMAGE_FSTYPES:append = " dataimg mender"

PREFERRED_PROVIDER:u-boot = "u-boot-stm32mp"

#########################################################
### Configure flashlayout for mender partition setup...

# ROOTFS is duplicated: A/B setup but we don't actually duplicate
# the *real* rootfs in the flashlayout because that would make the
# STM32_Cube_Programmer flash the actual rootfs image twice, thus taking
# twice the time to flash the system.
# So, the following trick is to declare a 'rootfsb' partition, whose size
# is the same as 'rootfs' but is marker to be 'empty.
# This way, the STM32_Cube_Programmer will reserve the space for the B
# partition without actually copying data, saving precious time.

# create phony rootfsb partition, with same size as rootfs
FLASHLAYOUT_PARTITION_LABELS:trusted:emmc:append = " rootfsb dataimg"

FLASHLAYOUT_PARTITION_ENABLE:rootfsb = "PED"
FLASHLAYOUT_PARTITION_SIZE:rootfsb = "${IMAGE_ROOTFS_SIZE}"
FLASHLAYOUT_PARTITION_BIN2LOAD:rootfsb = "none"
FLASHLAYOUT_PARTITION_TYPE:rootfsb = "FileSystem"

FLASHLAYOUT_PARTITION_BIN2LOAD:dataimg = "${IMAGE_NAME}.dataimg.ext4"
FLASHLAYOUT_PARTITION_TYPE:dataimg  = "FileSystem"
FLASHLAYOUT_PARTITION_ENABLE:dataimg = "P"

# IMAGE_NAME_SUFFIX is blank, which causes mkext2fs to fail
# if the -L ${IMAGE_NAME_SUFFIX} is provided
EXTRA_IMAGECMD:ext4:remove = "-L"

#
# for some reason, when building the rootfs this dependency isn't
# satisfied by yocto, despite the kernel metadata showing the creation of
# the kernel-devicetree package.
# with time, we may figure this out and replace thie "hack" with something else
# better-formed
MACHINE_ESSENTIAL_EXTRA_RDEPENDS:remove = " kernel-devicetree"
```

## meta-mender-odroid/conf/layer.conf
```bitbake
# Copyright 2020 Northern.tech AS

# We have a conf and classes directory, add to BBPATH
BBPATH .= ":${LAYERDIR}"

# We have recipes-* directories, add to BBFILES
BBFILES += "${LAYERDIR}/recipes-*/*/*.bb \
	${LAYERDIR}/recipes-*/*/*.bbappend"

BBFILE_COLLECTIONS += "mender-odroid"
BBFILE_PATTERN_mender-odroid = "^${LAYERDIR}/"
BBFILE_PRIORITY_mender-odroid = "10"

LAYERSERIES_COMPAT_mender-odroid = "zeus"
LAYERDEPENDS_mender-odroid = "mender odroid-layer"
```

## meta-mender-qemu-community/conf/layer.conf
```bitbake
# We have a conf and classes directory, add to BBPATH
BBPATH .= ":${LAYERDIR}"

# We have recipes-* directories, add to BBFILES
BBFILES += "${LAYERDIR}/recipes-*/*/*.bb \
            ${LAYERDIR}/recipes-*/*/*.bbappend"

BBFILE_COLLECTIONS += "meta-mender-qemu-community"
BBFILE_PATTERN_meta-mender-qemu-community = "^${LAYERDIR}/"
BBFILE_PRIORITY_meta-mender-qemu-community = "6"

LAYERDEPENDS_meta-mender-qemu-community = "core"
LAYERSERIES_COMPAT_meta-mender-qemu-community = "kirkstone"
```

## meta-mender-raspberrypi-community/conf/layer.conf
```bitbake
# We have a conf and classes directory, add to BBPATH
BBPATH .= ":${LAYERDIR}"

# We have recipes-* directories, add to BBFILES
BBFILES += "${LAYERDIR}/recipes-*/*/*.bb \
	${LAYERDIR}/recipes-*/*/*.bbappend"

BBFILE_COLLECTIONS += "mender-raspberrypi-community"
BBFILE_PATTERN_mender-raspberrypi-community = "^${LAYERDIR}/"
BBFILE_PRIORITY_mender-raspberrypi-community = "10"

LAYERDEPENDS_mender-raspberrypi-community = "mender raspberrypi mender-raspberrypi"

# Recommended for u-boot support for raspberrypi5
# https://git.yoctoproject.org/meta-lts-mixins 'scarthgap/u-boot' branch
LAYERRECOMMENDS_mender-raspberrypi-community = "lts-u-boot-mixin"

LAYERSERIES_COMPAT_mender-raspberrypi-community = "scarthgap"

# Raspberry Pi doesn't work with GRUB currently.
_MENDER_IMAGE_TYPE_DEFAULT:rpi = "mender-image-sd"
_MENDER_BOOTLOADER_DEFAULT:rpi = "mender-uboot"
```

## meta-mender-renesas/conf/layer.conf
```bitbake
# Board specific layer configuration for meta-mender
# Copyright 2023 estape

# We have a conf and classes directory, add to BBPATH
BBPATH .= ":${LAYERDIR}"

# We have recipes-* directories, add to BBFILES
BBFILES += "${LAYERDIR}/recipes-*/*/*.bb \
	${LAYERDIR}/recipes-*/*/*.bbappend"

BBFILE_COLLECTIONS += "mender-renesas"
BBFILE_PATTERN_mender-renesas = "^${LAYERDIR}/"

BBFILE_PRIORITY_mender-renesas = "6"

LAYERDEPENDS_mender-renesas = "mender"

LAYERSERIES_COMPAT_mender-renesas = "dunfell"

_MENDER_BOOTLOADER_DEFAULT ?= "mender-uboot"
```

## meta-mender-rockchip/conf/layer.conf
```bitbake
# Copyright 2018 Northern.tech AS

# We have a conf and classes directory, add to BBPATH
BBPATH .= ":${LAYERDIR}"

# We have recipes-* directories, add to BBFILES
BBFILES += "${LAYERDIR}/recipes-*/*/*.bb \
	${LAYERDIR}/recipes-*/*/*.bbappend"

BBFILE_COLLECTIONS += "mender-rockchip"
BBFILE_PATTERN_mender-rockchip = "^${LAYERDIR}/"
BBFILE_PRIORITY_mender-rockchip = "10"

LAYERSERIES_COMPAT_mender-rockchip = "kirkstone"
```
