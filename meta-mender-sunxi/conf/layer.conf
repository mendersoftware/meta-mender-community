## meta-mender-sunxi/conf/layer.conf
```bitbake
# Copyright 2018 Northern.tech AS

# We have a conf and classes directory, add to BBPATH
BBPATH .= ":${LAYERDIR}"

# We have recipes-* directories, add to BBFILES
BBFILES += "${LAYERDIR}/recipes-*/*/*.bb \
	${LAYERDIR}/recipes-*/*/*.bbappend"

BBFILE_COLLECTIONS += "mender-sunxi"
BBFILE_PATTERN_mender-sunxi = "^${LAYERDIR}/"
BBFILE_PRIORITY_mender-sunxi = "11"

LAYERSERIES_COMPAT_mender-sunxi = "thud"

LAYERDEPENDS_mender-sunxi = "meta-sunxi"
```

## meta-mender-tegra/conf/layer.conf
```bitbake
# We have a conf and classes directory, add to BBPATH
BBPATH .= ":${LAYERDIR}"
# We have recipes-* directories, add to BBFILES
BBFILES += "${LAYERDIR}/recipes-*/*/*.bb \
		${LAYERDIR}/recipes-*/*/*.bbappend"

BBFILE_COLLECTIONS += "meta-mender-tegra"
BBFILE_PATTERN_meta-mender-tegra = "^${LAYERDIR}/"
BBFILE_PRIORITY_meta-mender-tegra = "10"
LAYERVERSION_meta-mender-tegra = "1"
LAYERSERIES_COMPAT_meta-mender-tegra = "zeus"
LAYERDEPENDS_meta-mender-tegra = "tegra"
```

## meta-mender-tegra/meta-mender-tegra-common/conf/layer.conf
```bitbake
# We have a conf and classes directory, add to BBPATH
BBPATH .= ":${LAYERDIR}"
# We have recipes-* directories, add to BBFILES
BBFILES += "${LAYERDIR}/recipes-*/*/*.bb \
		${LAYERDIR}/recipes-*/*/*.bbappend"

BBFILE_COLLECTIONS += "meta-mender-tegra-common"
BBFILE_PATTERN_meta-mender-tegra-common = "^${LAYERDIR}/"
BBFILE_PRIORITY_meta-mender-tegra-common = "10"
LAYERVERSION_meta-mender-tegra-common = "1"
LAYERSERIES_COMPAT_meta-mender-tegra-common = "scarthgap"
LAYERDEPENDS_meta-mender-tegra-common = "tegra"
```

## meta-mender-tegra/meta-mender-tegra-jetpack5/conf/layer.conf
```bitbake
# We have a conf and classes directory, add to BBPATH
BBPATH .= ":${LAYERDIR}"
# We have recipes-* directories, add to BBFILES
BBFILES += "${LAYERDIR}/recipes-*/*/*.bb \
		${LAYERDIR}/recipes-*/*/*.bbappend"

BBFILE_COLLECTIONS += "meta-mender-tegra-jetpack5"
BBFILE_PATTERN_meta-mender-tegra-jetpack5 = "^${LAYERDIR}/"
BBFILE_PRIORITY_meta-mender-tegra-jetpack5 = "10"
LAYERVERSION_meta-mender-tegra-jetpack5 = "1"
LAYERSERIES_COMPAT_meta-mender-tegra-jetpack5 = "kirkstone"
LAYERDEPENDS_meta-mender-tegra-jetpack5 = "tegra"

BBMASK:tegra234:append = " \
	recipes-bsp/cboot/ \
	recipes-bsp/u-boot/patches \
	recipes-bsp/u-boot/libubootenv_.* \
	recipes-bsp/u-boot/u-boot.* \
	"
```

## meta-mender-tn-imx-bsp/conf/layer.conf
```bitbake
# Copyright 2020 Northern.tech AS

# We have a conf and classes directory, add to BBPATH
BBPATH .= ":${LAYERDIR}"

# We have recipes-* directories, add to BBFILES
BBFILES += "${LAYERDIR}/recipes-*/*/*.bb \
	${LAYERDIR}/recipes-*/*/*.bbappend"

BBFILE_COLLECTIONS += "mender-tn-imx-bsp"
BBFILE_PATTERN_mender-tn-imx-bsp = "^${LAYERDIR}/"
BBFILE_PRIORITY_mender-tn-imx-bsp = "10"

LAYERSERIES_COMPAT_mender-tn-imx-bsp = "zeus"

LAYERDEPENDS_mender-tn-imx-bsp = "meta-tn-imx-bsp mender"
```

## meta-mender-toradex-nxp/conf/layer.conf
```bitbake
# Copyright 2018 Northern.tech AS

# We have a conf and classes directory, add to BBPATH
BBPATH .= ":${LAYERDIR}"

# We have recipes-* directories, add to BBFILES
BBFILES += "${LAYERDIR}/recipes-*/*/*.bb \
	${LAYERDIR}/recipes-*/*/*.bbappend"

# Let us add layer-specific bbappends which are only applied when that
# layer is included in our configuration
BBFILES += "${@' '.join('${LAYERDIR}/%s/recipes*/*/*.bbappend' % layer \
               for layer in BBFILE_COLLECTIONS.split())}"

BBFILE_COLLECTIONS += "mender-community-toradex-nxp"
BBFILE_PATTERN_mender-community-toradex-nxp = "^${LAYERDIR}/"
BBFILE_PRIORITY_mender-community-toradex-nxp = "92"

LAYERSERIES_COMPAT_mender-community-toradex-nxp = "dunfell"

LAYERDEPENDS_mender-community-toradex-nxp = "mender toradex-nxp-layer"
```

## meta-mender-update-modules/conf/layer.conf
```bitbake
# Copyright 2019 Northern.tech AS

# We have a conf and classes directory, add to BBPATH
BBPATH .= ":${LAYERDIR}"

# We have recipes-* directories, add to BBFILES
BBFILES += "${LAYERDIR}/recipes-*/*/*.bb \
	${LAYERDIR}/recipes-*/*/*.bbappend"

BBFILE_COLLECTIONS += "mender-update-modules"
BBFILE_PATTERN_mender-update-modules = "^${LAYERDIR}/"
BBFILE_PRIORITY_mender-update-modules = "15"

LAYERSERIES_COMPAT_mender-update-modules = "rocko sumo thud warrior"
```

## meta-mender-validation/conf/layer.conf
```bitbake
# We have a conf and classes directory, add to BBPATH
BBPATH .= ":${LAYERDIR}"

# We have recipes-* directories, add to BBFILES
BBFILES += "${LAYERDIR}/recipes-*/*/*.bb \
            ${LAYERDIR}/recipes-*/*/*.bbappend"

BBFILE_COLLECTIONS += "meta-mender-validation"
BBFILE_PATTERN_meta-mender-validation = "^${LAYERDIR}/"
BBFILE_PRIORITY_meta-mender-validation = "6"

LAYERDEPENDS_meta-mender-validation = "core"
LAYERSERIES_COMPAT_meta-mender-validation = "scarthgap"
```

## meta-mender-variscite/conf/layer.conf
```bitbake
# We have a conf and classes directory, add to BBPATH
BBPATH .= ":${LAYERDIR}"

# We have recipes-* directories, add to BBFILES
BBFILES += "${LAYERDIR}/recipes-*/*/*.bb \
            ${LAYERDIR}/recipes-*/*/*.bbappend"

BBFILE_COLLECTIONS += "mender-variscite"
BBFILE_PATTERN_mender-variscite = "^${LAYERDIR}/"
BBFILE_PRIORITY_mender-variscite = "10"

LAYERDEPENDS_mender-variscite = "mender variscite-imx"

LAYERSERIES_COMPAT_mender-variscite = "zeus"
```
