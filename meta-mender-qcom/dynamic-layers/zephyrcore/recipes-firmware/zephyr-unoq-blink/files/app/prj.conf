## CMakeLists.txt
```
# Uno Q MCU demo: versioned LED blink (out-of-tree Zephyr application).
cmake_minimum_required(VERSION 3.20.0)

find_package(Zephyr REQUIRED HINTS $ENV{ZEPHYR_BASE})
project(unoq_mcu_blink C)

# Version + blink period are injected by the Yocto recipe (-D...), with sane
# fallbacks so a standalone `west build -b arduino_uno_q` still works.
if(NOT DEFINED FW_VERSION)
  set(FW_VERSION "unoq-mcu-dev")
endif()
if(NOT DEFINED BLINK_PERIOD_MS)
  set(BLINK_PERIOD_MS 500)
endif()

target_sources(app PRIVATE src/main.c)
target_compile_definitions(app PRIVATE
  FW_VERSION="${FW_VERSION}"
  BLINK_PERIOD_MS=${BLINK_PERIOD_MS}
)
```

## prj.conf
```kconfig
# Minimal config: GPIO for led0 + printk console output.
CONFIG_GPIO=y
CONFIG_PRINTK=y

# picolibc's getentropy references the board's zephyr,entropy device (the STM32
# RNG). Enable the entropy driver so that device is instantiated, otherwise the
# link fails with "undefined reference to __device_dts_ord_<n>".
CONFIG_ENTROPY_GENERATOR=y
```

## src/main.c
```c
/*
 * Uno Q MCU demo firmware: a versioned LED blink for the on-board STM32U585.
 *
 * FW_VERSION and BLINK_PERIOD_MS are injected at build time by the Yocto recipe
 * (see CMakeLists.txt), so v1/v2 differ only by recipe variables.
 *
 * fw_version[] is kept in its own .rodata section and marked "used" so it
 * survives link-time garbage collection. The Mender "zephyr-mcu" update module
 * reads this marker back over SWD (OpenOCD) to verify which firmware is running,
 * without needing a Linux-side comms channel to the MCU. The "UNOQMCU:" tag
 * makes it trivial to locate in a raw flash dump.
 */
#include <zephyr/kernel.h>
#include <zephyr/drivers/gpio.h>
#include <zephyr/sys/printk.h>

#ifndef FW_VERSION
#define FW_VERSION "unoq-mcu-dev"
#endif
#ifndef BLINK_PERIOD_MS
#define BLINK_PERIOD_MS 500
#endif

__attribute__((used, section(".rodata.fw_version")))
const char fw_version[] = "UNOQMCU:" FW_VERSION;

static const struct gpio_dt_spec led = GPIO_DT_SPEC_GET(DT_ALIAS(led0), gpios);

int main(void)
{
	printk("unoq-mcu firmware %s (blink %d ms)\n", fw_version, BLINK_PERIOD_MS);

	if (!gpio_is_ready_dt(&led)) {
		printk("unoq-mcu: led0 not ready\n");
		return 0;
	}
	if (gpio_pin_configure_dt(&led, GPIO_OUTPUT_ACTIVE) < 0) {
		printk("unoq-mcu: led0 configure failed\n");
		return 0;
	}

	while (1) {
		gpio_pin_toggle_dt(&led);
		k_msleep(BLINK_PERIOD_MS);
	}
	return 0;
}
```
